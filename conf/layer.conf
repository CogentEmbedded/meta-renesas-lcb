## conf/layer.conf
```bitbake
# We have a conf and classes directory, add to BBPATH
BBPATH .= ":${LAYERDIR}"

# We have a recipes-* directories, add to BBFILES
BBFILES += "${LAYERDIR}/recipes-*/*/*.bb \
	${LAYERDIR}/recipes-*/*/*.bbappend"

BBFILE_COLLECTIONS += "renesas-lcb"
BBFILE_PATTERN_renesas-lcb = "^${LAYERDIR}/"
BBFILE_PRIORITY_renesas-lcb = "6"

BBMASK ?= "external-linaro-toolchain|binutils_linaro.*"
BBMASK .= "|meta-renesas/common/recipes-devtools/gcc/libgcc_4.8.bbappend"
BBMASK .= "|meta-rcar-gen2/recipes-graphics/cogl/cogl-1.0_1.18.2.bbappend"
```

## conf/machine/gfx.conf
```bitbake
MULTI_PROVIDER_WHITELIST += "virtual/libgl virtual/egl virtual/libgles1 virtual/libgles2"

BBMASK_GFX = '${@ "" if 'sgx' in '${MACHINE_FEATURES}' or 'rgx' in '${MACHINE_FEATURES}' else "gles-kernel-module|gles-user-module"}'
BBMASK_GFX_TP = '${@ "" if 'gles-test' in '${DISTRO_FEATURES}' else "gles-test-module"}'

BBMASK .= '${@base_conditional("BBMASK_GFX", "", "", "|${BBMASK_GFX}", d)}'
BBMASK .= '${@base_conditional("BBMASK_GFX_TP", "", "", "|${BBMASK_GFX_TP}", d)}'

BBMASK .= "|meta-rcar-gen2/recipes-graphics/mesa/*"
BBMASK .= "|poky/meta/recipes-graphics/mesa/mesa_git*"

# Wayland/Weston - X11
BBMASK_WAYLAND = '${@ "" if 'wayland' in '${DISTRO_FEATURES}' else "meta-rcar-gen2/recipes-graphics/wayland/libegl|meta-rcar-gen2/recipes-graphics/wayland/libgbm|meta-rcar-gen2/recipes-graphics/wayland/wayland-kms"}'
BBMASK .= '${@base_conditional("BBMASK_WAYLAND", "", "", "|${BBMASK_WAYLAND}", d)}'

PREFERRED_PROVIDER_virtual/egl = '${@ "libegl" if 'wayland' in '${DISTRO_FEATURES}' else "gles-user-module"}'
PREFERRED_PROVIDER_virtual/libgles2 = "gles-user-module"

PREFERRED_PROVIDER_virtual/libgles1 = '${@ "" if 'wayland' in '${DISTRO_FEATURES}' else "mesa"}'
PREFERRED_PROVIDER_virtual/libgl = '${@ "" if 'wayland' in '${DISTRO_FEATURES}' else "mesa"}'
PREFERRED_PROVIDER_virtual/mesa = '${@ "" if 'wayland' in '${DISTRO_FEATURES}' else "mesa"}'
PREFERRED_PROVIDER_virtual/libgbm = '${@ "libgbm" if 'wayland' in '${DISTRO_FEATURES}' else ""}'
PREFERRED_PROVIDER_virtual/libgbm-dev = '${@ "libgbm" if 'wayland' in '${DISTRO_FEATURES}' else ""}'
```

## conf/machine/multimedia.conf
```bitbake
# Mask Multimedia recipes if not enabled and packages not supported on LCB
BB_MULTIMEDIA_KERNEL_MODULE = "fdpm-kernel-module|mmngr-kernel-module|mmngrbuf-kernel-module|s3ctl-kernel-module|uvcs-kernel-module|vspm-kernel-module"
BB_MULTIMEDIA_USER_MODULE = "fdpm-user-module|mmngr-user-module|mmngrbuf-user-module|omx-user-module|s3ctl-user-module|vspm-user-module"
BB_GST_PLUGINS = "meta-renesas/meta-rcar-gen2/recipes-multimedia/gstreamer"
BB_MULTIMEDIA_TEST_MODULE = "fdpm-tp-user-module|mmngr-tp-user-module|mmngrbuf-tp-user-module|s3ctl-tp-user-module|vspm-tp-user-module"
BB_DTV = "dtv-module|ssp-module|scu-module"

MULTIMEDIA_BB = "${BB_MULTIMEDIA_KERNEL_MODULE}|${BB_MULTIMEDIA_USER_MODULE}|${BB_GST_PLUGINS}"

BBMASK_MULTIMEDIA = '${@ "" if 'multimedia' in '${MACHINE_FEATURES}' else "${MULTIMEDIA_BB}"}'
BBMASK_MULTIMEDIA_TP = '${@ "" if 'multimedia' in '${MACHINE_FEATURES}' and 'mm-test' in '${DISTRO_FEATURES}' else "${BB_MULTIMEDIA_TEST_MODULE}" }'
BBMASK_DTV = '${@ "" if 'dtv' in '${MACHINE_FEATURES}' else "${BB_DTV}"}'

BBMASK .= '${@base_conditional("BBMASK_DTV", "", "", "|${BBMASK_DTV}", d)}'
BBMASK .= '${@base_conditional("BBMASK_MULTIMEDIA", "", "", "|${BBMASK_MULTIMEDIA}", d)}'
BBMASK .= '${@base_conditional("BBMASK_MULTIMEDIA_TP", "", "", "|${BBMASK_MULTIMEDIA_TP}", d)}'
```

## conf/machine/porter.conf
```bitbake
#@TYPE: Machine
#@NAME: porter
#@DESCRIPTION: Machine configuration for porter systems

require conf/machine/include/r8a7791.inc
require conf/machine/include/rcar-gen2-providers.inc

MACHINE_EXTRA_RRECOMMENDS = " kernel-modules"

IMAGE_FSTYPES += "tar.bz2"

SERIAL_CONSOLE = "38400 ttySC6"

KERNEL_DEVICETREE = "${S}/arch/arm/boot/dts/r8a7791-koelsch.dts"

KERNEL_EXTRA_ARGS += "LOADADDR=${UBOOT_ENTRYPOINT}"

UBOOT_MACHINE = "koelsch_config"
UBOOT_ENTRYPOINT = "0x40008000"
UBOOT_LOADADDRESS = "0x40007fc0"

PREFERRED_VERSION_linux-renesas = "3.10%"
PREFERRED_VERSION_linux-libc-headers = "3.10%"
PREFERRED_VERSION_nativesdk-linux-libc-headers = "3.10%"
PREFERRED_VERSION_u-boot = "v2013.01%"
PREFERRED_VERSION_libdrm = "2.4.45%"
PREFERRED_VERSION_mesa = "9.2.5"
PREFERRED_VERSION_gstreamer1.0 = "1.2.3"
PREFERRED_VERSION_gstreamer1.0-omx = "1.0.0"
PREFERRED_VERSION_gstreamer1.0-plugins-bad = "1.2.3"
PREFERRED_VERSION_gstreamer1.0-plugins-base = "1.2.3"
PREFERRED_VERSION_gstreamer1.0-plugins-good = "1.2.3"
PREFERRED_VERSION_gstreamer1.0-plugins-ugly = "1.2.3"
PREFERRED_VERSION_wayland = "1.5.0"
PREFERRED_VERSION_weston = "1.5.0"

MACHINE_FEATURES += " apm usbgadget usbhost vfat alsa ethernet"

require gfx.conf
require multimedia.conf
```
